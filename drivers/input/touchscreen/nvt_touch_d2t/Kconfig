## drivers/input/touchscreen/nvt_touch_d2t/Kconfig
```kconfig
#
# Novatek NT36xxx touchscreen driver configuration
#
config TOUCHSCREEN_NVT_D2T
	bool "Novatek NT36XXX"
	default n
	help
	  Say Y here if you have a Novatek NT36xxx touchscreen connected
	  to your system.

	  If unsure, say N.

config TOUCHSCREEN_NVT_D2T_MP_CTRLRAM
	bool "Novatek NT36XXX Multipoint Control RAM"
	depends on TOUCHSCREEN_NVT_D2T
	default n
	help
	  Say Y here if you need to use Multipoint Control RAM Testing

	  If unsure, say N.

config TOUCHSCREEN_NVT_D2T_ESD_PROTECT
	bool "Novatek NT36XXX ESD Touch Protect"
	depends on TOUCHSCREEN_NVT_D2T
	default n
	help
	  Say Y here if you need to use ESD Touch Protect.

	  If unsure, say N.
```

## drivers/kernelsu/Kconfig
```kconfig
menu "KernelSU"

config KERNELSU
	bool "Enable KernelSU Support"
	select OVERLAY_FS
	select KSU
	default n
	help
	Enable KSU support in kernel.

config KSU
	tristate "KernelSU function support"
	depends on OVERLAY_FS
	default n
	help
	Enable kernel-level root privileges on Android System.
	To compile as a module, choose M here: the
	module will be called kernelsu.

config KSU_KPROBES_HOOK
	bool "Use kprobes for kernelsu"
	depends on KSU
	depends on KPROBES
	default y
	help
	  Disable if you use manual hooks.

config KSU_DEBUG
	bool "KernelSU debug mode"
	depends on KSU
	default n
	help
	Enable KernelSU debug mode

endmenu
```

## drivers/platform/xiaomi/Kconfig
```kconfig
# Xiaomi configuration options

config MACH_XIAOMI
	bool "Xiaomi board"
	depends on ARCH_QCOM
	help
	 Support for Xiaomi boards.

config MACH_XIAOMI_MSM8998
	bool "Xiaomi MSM8998 boards"
	depends on ARCH_MSM8998
	select MACH_XIAOMI
	help
	 Support for MSM8998 Xiaomi boards.

config MACH_XIAOMI_SDM660
	bool "Xiaomi SDM660"
	depends on ARCH_SDM660
	select MACH_XIAOMI
	help
	  Support for Xiaomi SDM660 devices

menu "Xiaomi board selection"

config MACH_SAGIT
	bool "sagit board"
	select MACH_XIAOMI_MSM8998
	help
	 Support for Xiaomi Mi6, codenamed sagit.

config MACH_CHIRON
	bool "chiron board"
	select MACH_XIAOMI_MSM8998
	help
	 Support for Xiaomi Mi Mix2, codenamed chiron.

config MACH_XIAOMI_PLATINA
	bool "Xiaomi platina board"
	select MACH_XIAOMI_SDM660
	help
	  Support for Xiaomi Mi 8 Lite

endmenu
```
