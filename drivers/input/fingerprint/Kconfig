## drivers/input/fingerprint/Kconfig
```kconfig
#
# Fingerprint driver configuration
#

menuconfig INPUT_FINGERPRINT
	bool "Fingerprint"
	help
	  Say Y here, and a list of supported fingerprint will be displayed.
	  This option doesn't affect the kernel.

	  If unsure, say Y.

if INPUT_FINGERPRINT

source "drivers/input/fingerprint/cdfingerfp/Kconfig"

source "drivers/input/fingerprint/focaltech/Kconfig"

source "drivers/input/fingerprint/goodix/Kconfig"

source "drivers/input/fingerprint/fpc/Kconfig"

endif
```

## drivers/input/fingerprint/fpc/Kconfig
```kconfig
#-----------------------------------#
#    Kconfig for FingerprintCard    #
#-----------------------------------#

config FPC_FINGERPRINT
	default y
	tristate "fpc1020 fingerprint driver"
```
